## config/boards/shields/asteroid/Kconfig.defconfig
```kconfig
if SHIELD_ASTEROID_LEFT

config ZMK_KEYBOARD_NAME
    default "Asteroid"

config ZMK_SPLIT_ROLE_CENTRAL
    default y

endif

if SHIELD_ASTEROID_LEFT || SHIELD_ASTEROID_RIGHT

config ZMK_SPLIT
    default y

endif
```

## config/boards/shields/asteroid/Kconfig.shield
```kconfig
config SHIELD_ASTEROID_LEFT
    def_bool $(shields_list_contains,asteroid_left)

config SHIELD_ASTEROID_RIGHT
    def_bool $(shields_list_contains,asteroid_right)

if SHIELD_ASTEROID_LEFT

config ZMK_KEYBOARD_NAME
    default "Asteroid Left"

endif

if SHIELD_ASTEROID_RIGHT

config ZMK_KEYBOARD_NAME
    default "Asteroid Right"

endif

if SHIELD_ASTEROID_LEFT || SHIELD_ASTEROID_RIGHT

config ZMK_SPLIT
    default y

endif
```
